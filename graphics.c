const int8 background1[2][128]=
{
	{0x00,0x00,0x00,0x00,0x00,0x00,0x00,0x00,0x00,0x00,0x00,0xc0,0xe0,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0xe0,0x00}
	{0x00,0x00,0x00,0x00,0x00,0x00,0x00,0x00,0x00,0xfc,0xff,0xff,0xff,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0xff,0x00}
};

const int8 background2[2][128]=
{
	{0x00,0x00,0x00,0x00,0x00,0x00,0x00,0x00,0x00,0x00,0x03,0x0f,0x1f,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0x1f,0x00}
	{0x00,0x00,0x00,0x00,0x00,0x00,0x00,0x00,0x00,0x00,0x00,0x00,0x00,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0x08,0xf8}
};

const int8 background3[2][128]=
{
	{0x00,0x00,0x00,0x00,0x00,0x00,0x00,0x00,0x00,0x00,0x00,0x00,0x00,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0x22,0x1c}
	{0x00,0x00,0x00,0x00,0x00,0x00,0x00,0x00,0x00,0x00,0xc0,0xf0,0xf8,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0xf8,0x00}
};

const int8 background4[2][128]=
{
	{0x00,0x00,0x00,0x00,0x00,0x00,0x00,0x00,0x00,0x3f,0xff,0xff,0xff,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0xff,0x00}
	{0x00,0x00,0x00,0x00,0x00,0x00,0x00,0x00,0x00,0x00,0x00,0x03,0x07,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0x07,0x00} 
};

//vertical chars
const int8 FONT [14][7]=
{
	{0x0E, 0x11, 0x13, 0x15, 0x19, 0x11, 0x0E}	// 0
	{0x10, 0x10, 0x10, 0x10, 0x14, 0x18, 0x10}	// 1
	{0x1F, 0x02, 0x04, 0x08, 0x10, 0x11, 0x0E}	// 2
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	{0x00, 0x00, 0x00, 0x00, 0x00, 0x00, 0x00}	// space
};


/////////////////////////////////////////////////////////////////////////
// Purpose:       Draw a line on a graphic LCD using Bresenham's
//                line drawing algorithm
// Inputs:        (x1, y1) - the start coordinate
//                (x2, y2) - the end coordinate
//                color - ON or OFF
// Dependencies:  glcd_pixel()
/////////////////////////////////////////////////////////////////////////
void glcd_line(int8 x1, int8 y1, int8 x2, int8 y2, int1 color)
{
   int16        dy, dx;
   signed int8  addx=1, addy=1;
   signed int16 P, diff;

   #ifdef LARGE_LCD
   int16 i=0;
   dx = abs((signed int16)(x2 - x1));
   dy = abs((signed int16)(y2 - y1));
   #else
   int8 i=0;
   dx = abs((signed int8)(x2 - x1));
   dy = abs((signed int8)(y2 - y1));
   #endif

   if(x1 > x2)
      addx = -1;
   if(y1 > y2)
      addy = -1;

   if(dx >= dy)
   {
      dy *= 2;
      P = dy - dx;
      diff = P - dx;

      for(; i<=dx; ++i)
      {
         glcd_pixel(x1, y1, color);

         if(P < 0)
         {
            P  += dy;
            x1 += addx;
         }
         else
         {
            P  += diff;
            x1 += addx;
            y1 += addy;
         }
      }
   }
   else
   {
      dx *= 2;
      P = dx - dy;
      diff = P - dy;

      for(; i<=dy; ++i)
      {
         glcd_pixel(x1, y1, color);

         if(P < 0)
         {
            P  += dx;
            y1 += addy;
         }
         else
         {
            P  += diff;
            x1 += addx;
            y1 += addy;
         }
      }
   }
}


/////////////////////////////////////////////////////////////////////////
// Purpose:       Draw a rectangle on a graphic LCD
// Inputs:        (x1, y1) - the start coordinate
//                (x2, y2) - the end coordinate
//                fill  - YES or NO
//                color - ON or OFF
// Dependencies:  glcd_pixel(), glcd_line()
/////////////////////////////////////////////////////////////////////////
void glcd_rect(int8 x1, int8 y1, int8 x2, int8 y2, int1 fill, int1 color)
{
   if(fill)
   {
      #ifdef LARGE_LCD
      int16 i, xmin, xmax, ymin, ymax;
      #else
      int8  i, xmin, xmax, ymin, ymax;
      #endif

      if(x1 < x2)                            //  Find x min and max
      {
         xmin = x1;
         xmax = x2;
      }
      else
      {
         xmin = x2;
         xmax = x1;
      }

      if(y1 < y2)                            // Find the y min and max
      {
         ymin = y1;
         ymax = y2;
      }
      else
      {
         ymin = y2;
         ymax = y1;
      }

      for(; xmin <= xmax; ++xmin)
      {
         for(i=ymin; i<=ymax; ++i)
         {
            glcd_pixel(xmin, i, color);
         }
      }
   }
   else
   {
      glcd_line(x1, y1, x2, y1, color);      // Draw the 4 sides
      glcd_line(x1, y2, x2, y2, color);
      glcd_line(x1, y1, x1, y2, color);
      glcd_line(x2, y1, x2, y2, color);
   }
}


/////////////////////////////////////////////////////////////////////////
//show one vertical ascii char
/////////////////////////////////////////////////////////////////////////
void glcd_char(int8 x, int8 y, int8 ch, int1 color)
{
	int8 j, k;                       	// Loop counters

      for(j=0; j<7; ++j, x++)         // Loop through character byte data
      {
         for(k=0; k < 5; ++k)         // Loop through the vertical pixels
         {
            if(bit_test(FONT[ch][j], k)) // Check if the pixel should be set
            	glcd_pixel(x, y+k, color); // Draws the pixel
			else
				glcd_pixel(x, y+k, ~color);
         }
      }
}

void glcd_string(int8 x, int8 y, int8 str[], int1 color)
{
	int8 i, ch;

	for(i=0; str[i] != 0; i++)
	{
		if(str[i]=='.')
			ch=10;
		else if(str[i]==' ')
			ch=13;
		else
			ch=str[i]-48;		

		glcd_char(x, y, ch, color);
		y=y+6;
	}
}

// Purpose:    Fill the LCD screen with the passed in data
void glcd_fill(int8 data)
{
   int8 i, j;

   // Loop through the vertical pages
   for(i = 0; i < 8; ++i)
   {
      output_low(GLCD_DI);                      // Set for instruction
      glcd_writeByte(GLCD_LEFT, 0b01000000);    // Set horizontal address to 0
      glcd_writeByte(GLCD_RIGHT, 0b01000000);
      glcd_writeByte(GLCD_LEFT, i | 0b10111000);// Set page address
      glcd_writeByte(GLCD_RIGHT, i | 0b10111000);
      output_high(GLCD_DI);                     // Set for data

      // Loop through the horizontal sections
      for(j = 0; j < 64; ++j)
      {
         glcd_writeByte(GLCD_LEFT, data);  // Turn pixels on or off
         glcd_writeByte(GLCD_RIGHT, data); // Turn pixels on or off
      }
   }
}

void draw_background()
{
	int p,c,i;

	for(i=0; i<4; i++)
	{
		for(p=0; p<2; p++)
		{	
			output_low(GLCD_DI);
			glcd_writeByte(GLCD_LEFT, p|(184+i*2));		//set right page here (184 or 0xB8=page0)
			glcd_writeByte(GLCD_LEFT, 0x40);		//start poin, dont change if width 128
			output_high(GLCD_DI);		
			switch(i)
			{
				case 0: for(c=0; c<64; c++) glcd_writeByte(GLCD_LEFT, background1[p][c]);	break;
				case 1: for(c=0; c<64; c++) glcd_writeByte(GLCD_LEFT, background2[p][c]);	break;	
				case 2: for(c=0; c<64; c++) glcd_writeByte(GLCD_LEFT, background3[p][c]);	break;
				case 3: for(c=0; c<64; c++) glcd_writeByte(GLCD_LEFT, background4[p][c]);	break;
			}

			output_low(GLCD_DI);
			glcd_writeByte(GLCD_RIGHT, p|(184+i*2));		//set right page here (184 or 0xB8=page0)
			glcd_writeByte(GLCD_RIGHT, 0x40);		//start poin, dont change if width 128
	
			output_high(GLCD_DI);
			switch(i)
			{
				case 0: for(c=64; c<128; c++) glcd_writeByte(GLCD_RIGHT, background1[p][c]);	break;
				case 1: for(c=64; c<128; c++) glcd_writeByte(GLCD_RIGHT, background2[p][c]);	break;	
				case 2: for(c=64; c<128; c++) glcd_writeByte(GLCD_RIGHT, background3[p][c]);	break;
				case 3: for(c=64; c<128; c++) glcd_writeByte(GLCD_RIGHT, background4[p][c]);	break;
			}
		}
	}
}
